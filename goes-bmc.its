## goes-bmc.its
```
/*
 * U-boot uImage source file with kernel ramdisk and FDT blobs for BMC flavors
 */

/dts-v1/;

/ {
	description = "Various kernels, ramdisks and FDT blobs";
	#address-cells = <1>;

	images {
		kernel-1 {
			description = "ARM BMC kernel";
			data = /incbin/("./platina-mk1-bmc.vmlinuz");
			type = "kernel";
			arch = "arm";
			os = "linux";
			compression = "none";
			load = <0x80008000>;
			entry = <0x80008000>;
			hash-1 {
				algo = "md5";
			};
			hash-2 {
				algo = "sha256";
			};
		};

		ramdisk-1 {
			description = "ARM BMC ramdisk";
			data = /incbin/("./platina-mk1-bmc.cpio.xz");
			type = "ramdisk";
			arch = "arm";
			os = "linux";
			compression = "none";
			hash-1 {
				algo = "sha256";
			};
		};

		fdt-1 {
			description = "platina-mk1-bmc fdt";
			data = /incbin/("./platina-mk1-bmc-dtb.bin");
			type = "flat_dt";
			arch = "arm";
			compression = "none";
			hash-1 {
				algo = "sha256";
			};
		};
	};

	configurations {
		default = "config-1";

		config-1 {
			description = "BMC TOR configuration";
			kernel = "kernel-1";
			ramdisk = "ramdisk-1";
			fdt = "fdt-1";
		};
	};
};
```
